VERSION ""

NS_ :

BS_:

BU_: SlidingDoorController
VAL_TABLE_ SlidingDoorState 1 "Closed" 0 "Open" ;

BO_ 933 SlidingDoorController: 8 SlidingDoorController
 SG_ SlidingDoorState : 12|1@1+ (1,0) [0|1] "" Vector__XXX

CM_ SG_ 933 SlidingDoorState "Sliding door state";
BA_DEF_  "BusType" STRING ;
BA_DEF_DEF_  "BusType" "CAN";
VAL_ 933 SlidingDoorState 1 "Closed" 0 "Open" ;
